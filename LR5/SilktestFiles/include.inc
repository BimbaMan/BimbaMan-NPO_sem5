[-] window MainWin CDocumentsAndSettingsIvan
	[+] multitag "Z:\"
		[ ] "$Z:\"
	[+] Menu Файл
		[ ] tag "Файл"
		[+] MenuItem Открыть
			[+] multitag "Открыть"
				[ ] "$540"
		[+] MenuItem ОткрытьВнутри2
			[+] multitag "Открыть внутри"
				[ ] "$541"
		[+] MenuItem ОткрытьВнутри1
			[+] multitag "Открыть внутри ?[1]"
				[ ] "$590"
		[+] MenuItem ОткрытьВнутри3
			[+] multitag "Открыть внутри #"
				[ ] "$591"
		[+] MenuItem ОткрытьСнаружи
			[+] multitag "Открыть снаружи"
				[ ] "$542"
		[+] MenuItem Просмотр
			[+] multitag "Просмотр"
				[ ] "$543"
		[+] MenuItem Редактировать
			[+] multitag "Редактировать"
				[ ] "$544"
		[+] MenuItem Переименовать
			[+] multitag "Переименовать"
				[ ] "$545"
		[+] MenuItem КопироватьВ
			[+] multitag "Копировать в"
				[ ] "$546"
		[+] MenuItem ПереместитьВ
			[+] multitag "Переместить в"
				[ ] "$547"
		[+] MenuItem Удалить
			[+] multitag "Удалить"
				[ ] "$548"
		[+] MenuItem РазбитьФайл
			[+] multitag "Разбить файл"
				[ ] "$549"
		[+] MenuItem ОбъединитьФайлы
			[+] multitag "Объединить файлы"
				[ ] "$550"
		[+] MenuItem Свойства
			[+] multitag "Свойства"
				[ ] "$551"
		[+] MenuItem Комментарий
			[+] multitag "Комментарий"
				[ ] "$552"
		[+] Menu CRC
			[ ] tag "CRC"
			[+] MenuItem CRC32
				[+] multitag "CRC-32"
					[ ] "$102"
			[+] MenuItem CRC64
				[+] multitag "CRC-64"
					[ ] "$103"
			[+] MenuItem SHA1
				[+] multitag "SHA-1"
					[ ] "$104"
			[+] MenuItem SHA256
				[+] multitag "SHA-256"
					[ ] "$105"
			[+] MenuItem MenuItem5
				[+] multitag "?"
					[ ] "$101"
		[+] MenuItem Сравнить
			[+] multitag "Сравнить"
				[ ] "$554"
		[+] MenuItem СоздатьПапку
			[+] multitag "Создать Папку"
				[ ] "$555"
		[+] MenuItem СоздатьФайл
			[+] multitag "Создать Файл"
				[ ] "$556"
		[+] MenuItem Ссылка
			[+] multitag "Ссылка"
				[ ] "$558"
		[+] MenuItem АльтернативныеПотоки
			[+] multitag "Альтернативные Потоки"
				[ ] "$559"
		[+] MenuItem Выход
			[+] multitag "Выход"
				[ ] "$8"
	[+] Menu Правка
		[ ] tag "Правка"
		[+] MenuItem ВыделитьВсе
			[+] multitag "Выделить все"
				[ ] "$600"
		[+] MenuItem УбратьВыделение1
			[+] multitag "Убрать выделение[1]"
				[ ] "$601"
		[+] MenuItem ОбратитьВыделение
			[+] multitag "Обратить выделение"
				[ ] "$602"
		[+] MenuItem Выделить
			[+] multitag "Выделить"
				[ ] "$603"
		[+] MenuItem УбратьВыделение2
			[+] multitag "Убрать выделение[2]"
				[ ] "$604"
		[+] MenuItem ВыделитьПоТипу
			[+] multitag "Выделить по типу"
				[ ] "$605"
		[+] MenuItem УбратьВыделениеПоТипу
			[+] multitag "Убрать выделение по типу"
				[ ] "$606"
	[+] Menu Вид
		[ ] tag "Вид"
		[+] MenuItem КрупныеЗначки
			[+] multitag "Крупные значки"
				[ ] "$700"
		[+] MenuItem МелкиеЗначки
			[+] multitag "Мелкие значки"
				[ ] "$701"
		[+] MenuItem Список
			[+] multitag "Список"
				[ ] "$702"
		[+] MenuItem Таблица
			[+] multitag "Таблица"
				[ ] "$703"
		[+] MenuItem Имя
			[+] multitag "Имя"
				[ ] "$710"
		[+] MenuItem Тип
			[+] multitag "Тип"
				[ ] "$711"
		[+] MenuItem Изменен
			[+] multitag "Изменен"
				[ ] "$712"
		[+] MenuItem Размер
			[+] multitag "Размер"
				[ ] "$713"
		[+] MenuItem БезСортировки
			[+] multitag "Без сортировки"
				[ ] "$730"
		[+] MenuItem ПлоскийРежим
			[+] multitag "Плоский режим"
				[ ] "$731"
		[+] MenuItem N2Панели
			[+] multitag "2 Панели"
				[ ] "$732"
		[+] Menu N2017
			[ ] tag "2017"
			[+] MenuItem xTime
				[+] multitag "Time"
					[ ] "$761"
		[+] Menu ПанелиИнструментов
			[ ] tag "Панели инструментов"
			[+] MenuItem ПанельКнопокАрхиватора
				[+] multitag "Панель кнопок архиватора"
					[ ] "$750"
			[+] MenuItem СтандартнаяПанельКнопок
				[+] multitag "Стандартная панель кнопок"
					[ ] "$751"
			[+] MenuItem БольшиеКнопки
				[+] multitag "Большие кнопки"
					[ ] "$752"
			[+] MenuItem НадписиНаКнопках
				[+] multitag "Надписи на кнопках"
					[ ] "$753"
		[+] MenuItem ОткрытьКорневуюПапку
			[+] multitag "Открыть корневую папку"
				[ ] "$734"
		[+] MenuItem ПереходНаОдинУровеньВверх
			[+] multitag "Переход на один уровень вверх"
				[ ] "$735"
		[+] MenuItem ИсторияПапок
			[+] multitag "История папок"
				[ ] "$736"
		[+] MenuItem Обновить
			[+] multitag "Обновить"
				[ ] "$737"
		[+] MenuItem Автообновление
			[+] multitag "Автообновление"
				[ ] "$738"
	[+] Menu Избранное
		[ ] tag "Избранное"
		[+] Menu ДобавитьПапкуВИзбранноеКак
			[ ] tag "Добавить папку в избранное как"
	[+] Menu Сервис
		[ ] tag "Сервис"
		[+] MenuItem Настройки
			[+] multitag "Настройки"
				[ ] "$900"
		[+] MenuItem ТестированиеПроизводительност
			[+] multitag "Тестирование производительности"
				[ ] "$901"
	[+] Menu Справка
		[ ] tag "Справка"
		[+] MenuItem Оглавление
			[+] multitag "Оглавление"
				[ ] "$960"
		[+] MenuItem ОПрограмме
			[+] multitag "О программе"
				[ ] "$961"
	[+] ToolBar ToolBar1
		[ ] tag "$0"
		[+] PushButton Добавить
			[+] multitag "Добавить"
				[ ] "$1070"
		[+] PushButton Извлечь
			[+] multitag "Извлечь"
				[ ] "$1071"
		[+] PushButton Тестировать
			[+] multitag "Тестировать"
				[ ] "$1072"
		[+] PushButton Копировать
			[+] multitag "Копировать"
				[ ] "$546"
		[+] PushButton Переместить
			[+] multitag "Переместить"
				[ ] "$547"
		[+] PushButton Удалить
			[+] multitag "Удалить"
				[ ] "$548"
		[+] PushButton Информация
			[+] multitag "Информация"
				[ ] "$551"
	[+] CustomWin N7ZipPanel1
		[ ] tag "[7-Zip::Panel]$1000"
		[+] ListView ListView1
			[ ] tag "$1001"
			[+] Header Header1
				[ ] tag "$0"
				[+] PushButton Имя
					[ ] tag "Имя"
				[+] PushButton Размер
					[ ] tag "Размер"
				[+] PushButton Изменен
					[ ] tag "Изменен"
				[+] PushButton Создан
					[ ] tag "Создан"
				[+] PushButton Комментарий
					[ ] tag "Комментарий"
				[+] PushButton Папок
					[ ] tag "Папок"
				[+] PushButton Файлов
					[ ] tag "Файлов"
		[+] CustomWin ReBarWindow321
			[ ] tag "[ReBarWindow32]$0"
			[+] ComboBox ComboBox1
				[ ] tag "$1003"
			[+] ToolBar ToolBar1
				[ ] tag "$1002"
				[+] PushButton PushButton1
					[ ] tag "$100"
		[+] StatusBar StatusBar1
			[ ] tag "$1004"
			[+] DynamicText DynamicText1
				[ ] tag "#1"
			[+] DynamicText DynamicText2
				[ ] tag "#2"
			[+] DynamicText DynamicText3
				[ ] tag "#3"
			[+] DynamicText DynamicText4
				[ ] tag "#4"
